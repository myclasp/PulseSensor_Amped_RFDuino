/*

Changed to RFDuino style interrupts and timers. I used code here from
bhabrooo at http://forum.rfduino.com/index.php?topic=155.0

*/


volatile int rate[10];                    // used to hold last ten IBI values
volatile unsigned long sampleCounter = 0;          // used to determine pulse timing
volatile unsigned long lastBeatTime = 0;           // used to find the inter beat interval
volatile int P =512;                      // used to find peak in pulse wave
volatile int T = 512;                     // used to find trough in pulse wave
volatile int thresh = 512;                // used to find instant moment of heart beat
volatile int amp = 100;                   // used to hold amplitude of pulse waveform
volatile boolean firstBeat = true;        // used to seed rate array so we startup with reasonable BPM
volatile boolean secondBeat = true;       // used to seed rate array so we startup with reasonable BPM


//void timer(unsigned int ms)                                 // directly pass the value you want the cycle to be in mS
void interruptSetup()
{
  unsigned int ms=2;
  NRF_TIMER2->TASKS_STOP = 1;	                                   // Stop timer
  NRF_TIMER2->MODE = TIMER_MODE_MODE_Timer;                        // sets the timer to TIME mode (doesn't make sense but OK!)
  NRF_TIMER2->BITMODE = TIMER_BITMODE_BITMODE_16Bit;               // with BLE only Timer 1 and Timer 2 and that too only in 16bit mode
  NRF_TIMER2->PRESCALER = 9;	                                   // Prescaler 9 produces 31250 Hz timer frequency => t = 1/f =>  32 uS
                                                                   // The figure 31250 Hz is generated by the formula (16M) / (2^n) 
                                                                   // where n is the prescaler value 
                                                                   // hence (16M)/(2^9)=31250 
  NRF_TIMER2->TASKS_CLEAR = 1;                                     // Clear timer
  
  //-------------------------------------------------------------------------------------------------------------------------------------------------------------------------------------
  //        Conversion to make cycle calculation easy
  //        Since the cycle is 32 uS hence to generate cycles in mS we need 1000 uS 
  //        1000/32 = 31.25  Hence we need a multiplication factor of 31.25 to the required cycle time to achive it
  //        e.g to get a delay of 10 mS      we would do
  //        NRF_TIMER2->CC[0] = (10*31)+(10/4);
  //-------------------------------------------------------------------------------------------------------------------------------------------------------------------------------------
 
  NRF_TIMER2->CC[0] = (ms * 31) + (ms / 4);                                                                                  //CC[0] register holds interval count value i.e your desired cycle
  NRF_TIMER2->INTENSET = TIMER_INTENSET_COMPARE0_Enabled << TIMER_INTENSET_COMPARE0_Pos;                                     // Enable COMAPRE0 Interrupt
  NRF_TIMER2->SHORTS = (TIMER_SHORTS_COMPARE0_CLEAR_Enabled << TIMER_SHORTS_COMPARE0_CLEAR_Pos);                             // Count then Complete mode enabled
  attachInterrupt(TIMER2_IRQn, TIMER2_Interrupt);                                                                            // also used in variant.cpp in the RFduino2.2 folder to configure the RTC1 
  NRF_TIMER2->TASKS_START = 1;	                                                                                             // Start TIMER
}



// generate the square wave
void TIMER2_Interrupt(void)
{
  if (NRF_TIMER2->EVENTS_COMPARE[0] != 0)
  {

    
    
    
            //cli();                                      // disable interrupts while we do this
            Signal = analogRead(pulsePin);              // read the Pulse Sensor 
            sampleCounter += 2;                         // keep track of the time in mS with this variable
            int N = sampleCounter - lastBeatTime;       // monitor the time since the last beat to avoid noise
        
        //  find the peak and trough of the pulse wave
            if(Signal < thresh && N > (IBI/5)*3){       // avoid dichrotic noise by waiting 3/5 of last IBI
                if (Signal < T){                        // T is the trough
                    T = Signal;                         // keep track of lowest point in pulse wave 
                 }
               }
              
            if(Signal > thresh && Signal > P){          // thresh condition helps avoid noise
                P = Signal;                             // P is the peak
               }                                        // keep track of highest point in pulse wave
            
          //  NOW IT'S TIME TO LOOK FOR THE HEART BEAT
          // signal surges up in value every time there is a pulse
        if (N > 250){                                   // avoid high frequency noise
          if ( (Signal > thresh) && (Pulse == false) && (N > (IBI/5)*3) ){        
            Pulse = true;                               // set the Pulse flag when we think there is a pulse
            //digitalWrite(blinkPin,HIGH);                // turn on pin 13 LED
            IBI = sampleCounter - lastBeatTime;         // measure time between beats in mS
            lastBeatTime = sampleCounter;               // keep track of time for next pulse
                 
                 if(firstBeat){                         // if it's the first time we found a beat, if firstBeat == TRUE
                     firstBeat = false;                 // clear firstBeat flag
                     return;                            // IBI value is unreliable so discard it
                    }   
                 if(secondBeat){                        // if this is the second beat, if secondBeat == TRUE
                    secondBeat = false;                 // clear secondBeat flag
                       for(int i=0; i<=9; i++){         // seed the running total to get a realisitic BPM at startup
                            rate[i] = IBI;                      
                            }
                    }
                  
            // keep a running total of the last 10 IBI values
            word runningTotal = 0;                   // clear the runningTotal variable    
        
            for(int i=0; i<=8; i++){                // shift data in the rate array
                  rate[i] = rate[i+1];              // and drop the oldest IBI value 
                  runningTotal += rate[i];          // add up the 9 oldest IBI values
                }
                
            rate[9] = IBI;                          // add the latest IBI to the rate array
            runningTotal += rate[9];                // add the latest IBI to runningTotal
            runningTotal /= 10;                     // average the last 10 IBI values 
            BPM = 60000/runningTotal;               // how many beats can fit into a minute? that's BPM!
            QS = true;                              // set Quantified Self flag 
            // QS FLAG IS NOT CLEARED INSIDE THIS ISR
            }                       
        }
        
          if (Signal < thresh && Pulse == true){     // when the values are going down, the beat is over
              //digitalWrite(blinkPin,LOW);            // turn off pin 13 LED
              Pulse = false;                         // reset the Pulse flag so we can do it again
              amp = P - T;                           // get amplitude of the pulse wave
              thresh = amp/2 + T;                    // set thresh at 50% of the amplitude
              P = thresh;                            // reset these for next time
              T = thresh;
             }
          
          if (N > 2500){                             // if 2.5 seconds go by without a beat
              thresh = 512;                          // set thresh default
              P = 512;                               // set P default
              T = 512;                               // set T default
              lastBeatTime = sampleCounter;          // bring the lastBeatTime up to date        
              firstBeat = true;                      // set these to avoid noise
              secondBeat = true;                     // when we get the heartbeat back
             }
          
          //sei();                                     // enable interrupts when youre done!
    
    
    
    
    
    
    
    NRF_TIMER2->EVENTS_COMPARE[0] = 0;
  }
}


